//============================================================================
//  Name:                                                                     
//    std_extensions.cmm 
//
//  Description:                                                              
//    None 
//                                                                            
// Copyright (c) 2016 by QUALCOMM, Incorporated.  All Rights Reserved.        
//============================================================================
//                                                                            
// *** AUTO GENERATED FILE - DO NOT EDIT                                      
//                                                                            
// GENERATED: Sun Mar 27 23:05:58 2016 
//============================================================================

ENDDO