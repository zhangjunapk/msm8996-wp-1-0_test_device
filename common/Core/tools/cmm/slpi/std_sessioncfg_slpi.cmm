//============================================================================
//  Name:                                                                     
//    std_sessioncfg_slpi.cmm 
//
//  Description:                                                              
//    Script to setup sub-system level features
//                                                                            
// Copyright (c) 2012 - 2014 by Qualcomm Technologies, Incorporated.  All Rights Reserved.        
//
//
//
//
//                      EDIT HISTORY FOR FILE
//  This section contains comments describing changes made to the module.
//  Notice that changes are listed in reverse chronological order.
//
// when       who     		what, where, why
// --------   ---     		---------------------------------------------------------
// 01/13/2015 JBILLING          Created for SLPI. Ported from std_sessioncfg_adsp

// We support only one argument for all session config scripts
// ARG0 - Chipset Name. Can be used to setup sub-system according to target if needed 
// Using this argument should be avoided unless absolutely necessary
ENTRY &ARG0

MAIN:
	// Do common environment setup
	do std_setupenv.cmm

	// Clear all the windows
	WINCLEAR

	// Now RPM specific setup
	// RPM Build should be populated already
	IF ("&SLPI_BUILDROOT"!="")
	(
		// The assumption is that this script will be called only for a change in state of the debugging session
		// Reset the menus to default values
		MENU.RESET

		// Load the extensions for the system
		do std_utils EXECUTESCRIPT EXIT &SLPI_BUILDROOT/slpi_proc/core/products/scripts/std_extensions.cmm

		// Load the relative path info for the build
		do std_utils EXECUTESCRIPT EXIT &SLPI_BUILDROOT/slpi_proc/core/products/scripts/std_toolsconfig.cmm
		
		// Program the menus for general debugging
		do std_utils EXECUTESCRIPT EXIT &SLPI_BUILDROOT/slpi_proc/core/products/scripts/std_scripts.men
	
		// Load anything else from the meta build
		do std_utils EXECUTESCRIPT EXIT &METASCRIPTSDIR/slpi/std_commands_slpi.men	

	)
	ELSE
	(
		PRINT %ERROR "SLPI Build Information not populated"
		GOTO FATALEXIT
	)

	do std_versionchecker
    
FATALEXIT:
	END

EXIT:
   ENDDO
   

