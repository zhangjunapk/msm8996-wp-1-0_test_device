//============================================================================
//  Name:                                                                     
//    DAP_MPSS.cmm
//
//  Description:                                                              
//    Setup script for the Modem Sub-system
//                                                                            
// Copyright (c) 2012 - 2014 by Qualcomm Technologies, Incorporated.  All Rights Reserved.        
//
//
//
//
//                      EDIT HISTORY FOR FILE
//  This section contains comments describing changes made to the module.
//  Notice that changes are listed in reverse chronological order.
//
// when       who             what, where, why
// --------   ---             ---------------------------------------------------------
// 07/28/2014 AJCheriyan    Created for Elessar
//

// The script accepts two input arguments
// ARG0 - Chipset name
// ARG1 - Core number
// Ideal case, the argument 'ARG0' would not have to be used
// as the parameters for a sub-system should be the same
// across the entire family of chipsets

ENTRY &ARG0 &ARG1 &ARG2

MAIN:
    &ARG0=STR.UPR("&ARG0")
    
    IF (("&ARG0"=="MSM8994"))
    (
        SYSTEM.CPU CORTEXM3
        SYSTEM.CONFIG SLAVE ON    

        SYSTEM.JTAGCLOCK 15.0MHZ

        SYSTEM.CONFIG.DAPIRPOST 16.
        SYSTEM.CONFIG.DAPDRPOST 2.
        SYSTEM.CONFIG.DAPIRPRE 0.
        SYSTEM.CONFIG.DAPDRPRE 0.
        
        SYSTEM.CONFIG.MEMORYACCESSPORT 4
        SYSTEM.CONFIG.DEBUGACCESSPORT 1
        SYSTEM.CONFIG.JTAGACCESSPORT 2
        SYSTEM.CONFIG.AXIACCESSPORT 4

    )
    IF (("&ARG0"=="MSM8996"))
    (
        SYSTEM.CPU CORTEXM3

        SYSTEM.JTAGCLOCK 10.0MHZ

        SYStem.OPTION WAITRESET OFF
        SYStem.OPTION ENRESET OFF
        SYStem.OPTION RESBREAK OFF
        SYStem.CONFIG SLAVE ON
        
        SYStem.CONFIG DAPIRPOST 0.
        SYStem.CONFIG DAPDRPOST 0.
        SYStem.CONFIG DAPIRPOST 16.
        SYStem.CONFIG DAPDRPOST 2.
        
        SYSTEM.CONFIG.MEMORYACCESSPORT 4
        SYSTEM.CONFIG.DEBUGACCESSPORT 1
        SYStem.CONFIG AHBACCESSPORT    0.
        SYStem.CONFIG APBACCESSPORT    1.
        SYStem.CONFIG AXIACCESSPORT    0.

        SYStem.MEMACCESS DAP
    )
    IF (("&ARG0"=="MSM8992"))
    (
        SYSTEM.CPU CORTEXM3
        SYSTEM.CONFIG SLAVE ON    

        SYSTEM.JTAGCLOCK 15.0MHZ

        SYSTEM.CONFIG.DAPIRPOST 16.
        SYSTEM.CONFIG.DAPDRPOST 2.
        SYSTEM.CONFIG.DAPIRPRE 0.
        SYSTEM.CONFIG.DAPDRPRE 0.
        
        SYSTEM.CONFIG.MEMORYACCESSPORT 4
        SYSTEM.CONFIG.DEBUGACCESSPORT 1
        SYSTEM.CONFIG.JTAGACCESSPORT 2
        SYSTEM.CONFIG.AXIACCESSPORT 4

    )
    IF (("&ARG0"=="MSM8974"))
    (
        SYSTEM.CPU HEXAGONV5 
        SYSTEM.CONFIG SLAVE ON    

        SYSTEM.JTAGCLOCK 15.0MHZ

        SYSTEM.CONFIG.DAPIRPOST 16.
        SYSTEM.CONFIG.DAPDRPOST 2.
        SYSTEM.CONFIG.DAPIRPRE 0.
        SYSTEM.CONFIG.DAPDRPRE 0.
        SYSTEM.CONFIG.MEMORYACCESSPORT 0
        SYSTEM.CONFIG.DEBUGACCESSPORT 1
        SYSTEM.CONFIG.JTAGACCESSPORT 2
        SYSTEM.CONFIG.COREJTAGPORT 0
        
        MMU.TABLEWALK ON
    )

    IF (("&ARG0"=="MSM8X26"))
    (
        SYSTEM.CPU HEXAGONV5 
        SYSTEM.CONFIG SLAVE ON    

        SYSTEM.JTAGCLOCK 15.0MHZ
        SYSTEM.CONFIG.DAPIRPOST 16.
        SYSTEM.CONFIG.DAPDRPOST 2.
        SYSTEM.CONFIG.DAPIRPRE 0.
        SYSTEM.CONFIG.DAPDRPRE 0.
        SYSTEM.CONFIG.MEMORYACCESSPORT 0
        SYSTEM.CONFIG.DEBUGACCESSPORT 1
        SYSTEM.CONFIG.JTAGACCESSPORT 2
        SYSTEM.CONFIG.COREJTAGPORT 0
        
        MMU.TABLEWALK ON        
    )

    IF (("&ARG0"=="MSM8X10"))
    (
        SYSTEM.CPU HEXAGONV5 
        SYSTEM.CONFIG SLAVE ON    

        SYSTEM.JTAGCLOCK 15.0MHZ
        SYSTEM.CONFIG.DAPIRPOST 16.
        SYSTEM.CONFIG.DAPDRPOST 2.
        SYSTEM.CONFIG.DAPIRPRE 0.
        SYSTEM.CONFIG.DAPDRPRE 0.
        SYSTEM.CONFIG.MEMORYACCESSPORT 0
        SYSTEM.CONFIG.AXIACCESSPORT 0
        SYSTEM.CONFIG.DEBUGACCESSPORT 1
        SYSTEM.CONFIG.JTAGACCESSPORT 2
        SYSTEM.CONFIG.COREJTAGPORT 0
        
        MMU.TABLEWALK ON
    )
    
    IF (("&ARG0"=="MDM9X25"))
    (
        SYSTEM.CPU HEXAGONV5 
        SYSTEM.CONFIG SLAVE ON    

        SYSTEM.JTAGCLOCK 15.0MHZ

        SYSTEM.CONFIG.DAPIRPOST 16.
        SYSTEM.CONFIG.DAPDRPOST 2.
        SYSTEM.CONFIG.DAPIRPRE 0.
        SYSTEM.CONFIG.DAPDRPRE 0.
        SYSTEM.CONFIG.MEMORYACCESSPORT 0
        SYSTEM.CONFIG.DEBUGACCESSPORT 1
        SYSTEM.CONFIG.JTAGACCESSPORT 2
        SYSTEM.CONFIG.COREJTAGPORT 0
        
        // Other settings
        MMU.TABLEWALK ON
        
        // SYSTEM.CONFIG SWDPTARGETSEL    0x107F50E1
    )

    // Common settings for all chipsets
    IF (("&ARG2"=="SWD")||("&ARG2"=="swd"))
    (
        SYSTEM.CONFIG SWDP ON 
        SYSTEM.CONFIG DEBUGPORTTYPE SWD
    )

    // Launch startup scripts
    IF (OS.ENV(STARTUPCMM)!="")
    (
        &STARTUPSCRIPT=OS.ENV(STARTUPCMM)
        do &STARTUPSCRIPT
    )
    
EXIT:
    ENDDO
