//============================================================================
//  Name:                                                                     
//    startupsim.cmm 
//
//  Description:                                                              
//    Common simulator startup script that calls the processor specific init scripts 
//                                                                            
// Copyright (c) 2012 - 2014 by Qualcomm Technologies, Incorporated.  All Rights Reserved.        
//
//
//
//
//                      EDIT HISTORY FOR FILE
//  This section contains comments describing changes made to the module.
//  Notice that changes are listed in reverse chronological order.
//
// when       who           what, where, why
// --------   ---           ---------------------------------------------------------
// 10/26/2015 JBILLING      Changed location of gen_buildflavor.cmm
// 07/01/2014 AJCheriyan    Load asic product flavor information as well
// 07/10/2012 AJCheriyan    Created for B-family
//

// Supports three input arguments 
// ARG0 - T32 connection property (SIM)
// ARG1 - Chipset Name 
// ARG2 - Sub-system Name
// ARG3 - Core Number

ENTRY &ARG0 &ARG1 &ARG2 &ARG3

// Global variables for the args passed in
GLOBAL &T32PROP &CHIPSET &SUBSYS &CORENUM

// Save the arguments 
&T32PROP=STR.LWR("&ARG0")
&CHIPSET=STR.LWR("&ARG1")
&SUBSYS=STR.LWR("&ARG2")
&CORENUM=STR.LWR("&ARG3")

// Locals used
LOCAL &SUBSYSCRIPT &SESSIONSCRIPT

// Now setup the scripts information first
PRINT "Calling script: std_toolsconfig with args: &ARG1"
do std_toolsconfig &CHIPSET &SUBSYS

// Now load the flavor information of this combination of builds
// This is an assumption : asic is the default flavor.
PRINT "Calling script: gen_buildflavor"
GLOBAL &BUILD_FLAVOR_SCRIPT
IF FILE.EXIST(&METASCRIPTSDIR/../../../build/app/gen_buildflavor.cmm)
(
    &BUILD_FLAVOR_SCRIPT="&METASCRIPTSDIR/../../../build/app/gen_buildflavor.cmm"
)
ELSE IF (FILE.EXIST(&METASCRIPTSDIR/gen/gen_buildflavor.cmm))
(
    &BUILD_FLAVOR_SCRIPT="&METASCRIPTSDIR/gen/gen_buildflavor.cmm"
)
ELSE
(
            WINPOS 0. 0. 50. 10.
            area.create gen_buildflavor
            AREA.SELECT gen_buildflavor
            area.view gen_buildflavor
            PRINT %ERROR "   Warning! gen_buildflavor.cmm not found!" 
            PRINT " "
            PRINT %ERROR "   Metabuild binary paths, "
            PRINT %ERROR "   ELF file paths and build "
            PRINT %ERROR "   flavors will be missing."
            PRINT " "
            PRINT " "
            PRINT " "
            area.select A000
            wait.2s
    
    &BUILD_FLAVOR_SCRIPT="NULL"
)

IF "&BUILD_FLAVOR_SCRIPT"!="NULL"
(

        // This means there is just one product flavor
        do &BUILD_FLAVOR_SCRIPT asic
)

// Now perform the debug session specific setup
PRINT "Calling script to load logs: std_loadsim.cmm"
do std_loadsim &CHIPSET


ENDDO
