ENTRY &ARG0

GLOBAL &HLOS_TYPE
GLOBAL &TZ_BUILDID
GLOBAL &CHIPID
GLOBAL &MPSS_ELF
GLOBAL &CPE_ELF
GLOBAL &BOOT_TZ_MBN
GLOBAL &MBA_BINARY
GLOBAL &UEFISECAPP_BINARY
GLOBAL &MPSS_BINARY
GLOBAL &APPSCONFIG_BINARY
GLOBAL &MBA_ELF
GLOBAL &ADSP_BINARY
GLOBAL &RPM_ELF
GLOBAL &QSEE_ELF
GLOBAL &SLPI_PD2_ELF
GLOBAL &HYP_BINARY
GLOBAL &CPE_BINARY
GLOBAL &VENUS_ELF
GLOBAL &SLPI_ELF
GLOBAL &MON_ELF
GLOBAL &SLPI_BINARY
GLOBAL &TZ_BINARY
GLOBAL &BOOT_ELF
GLOBAL &RPM_BINARY
GLOBAL &HYP_ELF
GLOBAL &PMIC_BINARY
GLOBAL &ADSP_PD2_ELF
GLOBAL &WINSECAPP_BINARY
GLOBAL &VENUS_BINARY
GLOBAL &TZDEVCFG_BINARY
GLOBAL &EFIESP_BINARY
GLOBAL &ADSP_ELF
GLOBAL &UEFISEC_BINARY
GLOBAL &BOOT_BINARY

IF ("&ARG0"=="asic")
(
	&PRODUCT_FLAVOR="asic"
	&HLOS_TYPE="WP"
	&TZ_BUILDID="IADAANAA"
	&CHIPID="msm8996"
	&MPSS_ELF="modem_proc\build\ms\M89968996.gen.prodQ00288_MCFG_HW.elf"
	&MPSS_ELF="modem_proc\build\ms\M89968996.gen.prodQ00288.elf"
	&MPSS_ELF="modem_proc\build\ms\M89968996.gen.prodQ00288_NODEVCFG.elf"
	&MPSS_ELF="modem_proc\build\ms\M89968996.gen.prodQ00288_DEVCFG.elf"
	&MPSS_ELF="modem_proc\build\ms\M89968996.gen.prodQ00288_MCFG_SW.elf"
	&MPSS_ELF="modem_proc\build\ms\M89968996.gen.prodQ00288_reloc.elf"
	&CPE_ELF="cpe_proc\build\bsp\cpe_link\build\AAAAAAAA\CPE_PROC_IMG_AAAAAAAAQ.elf"
	&BOOT_TZ_MBN="trustzone_images\build\ms\bin\IADAANAA\tz.mbn"
	&MBA_BINARY="modem_proc\build\ms\bin\8996.gen.prod\mba.mbn"
	&UEFISECAPP_BINARY="trustzone_images\build\ms\bin\IADAANAA\uefi_sec.mbn"
	&MPSS_BINARY="modem_proc\build\ms\bin\8996.gen.prod\qdsp6sw.mbn"
	&APPSCONFIG_BINARY="WP\Packages\QCOM\prebuilt\8996\firmware\8996\8996_MTP_WP\fat16.bin"
	&MBA_ELF="modem_proc\core\bsp\mba_img\build\8996.gen.prod\MBA_CORE_IMG_8996.gen.prodQ.elf"
	&ADSP_BINARY="adsp_proc\obj\qdsp6v5_ReleaseG\signed\adsp.mbn"
	&RPM_ELF="rpm_proc\core\bsp\rpm\build\RPM_AAAAANAAR.elf"
	&QSEE_ELF="trustzone_images\core\bsp\qsee\build\IADAANAA\qsee.elf"
	&SLPI_PD2_ELF="slpi_proc\build\ms\M8996AAAAAAAAQ1234_SENSOR.elf"
	&HYP_BINARY="trustzone_images\build\ms\bin\IADAANAA\hyp.mbn"
	&CPE_BINARY="cpe_proc\build\ms\bin\AAAAAAAAQ\cpe_9335.mbn"
	&VENUS_ELF="venus_proc\build\bsp\asic\build\PROD\venus.elf"
	&SLPI_ELF="slpi_proc\build\ms\M8996AAAAAAAAQ1234.elf"
	&MON_ELF="trustzone_images\core\bsp\monitor\build\IADAANAA\mon.elf"
	&SLPI_BINARY="slpi_proc\obj\qdsp6v5_ReleaseG\slpi.mbn"
	&TZ_BINARY="trustzone_images\build\ms\bin\IADAANAA\tz.mbn"
	&RPM_BINARY="rpm_proc\build\ms\bin\AAAAANAAR\rpm.mbn"
	&HYP_ELF="trustzone_images\core\bsp\hypervisor\build\IADAANAA\hyp.elf"
	&PMIC_BINARY="boot_images\QcomPkg\Msm8996Pkg\Bin64\pmic.elf"
	&ADSP_PD2_ELF="adsp_proc\build\ms\M8996AAAAAAAAQ1234_AUDIO.elf"
	&WINSECAPP_BINARY="trustzone_images\build\ms\bin\IADAANAA\winsecap.mbn"
	&VENUS_BINARY="venus_proc\build\bsp\asic\build\PROD\mbn\reloc\signed\venus.mbn"
	&TZDEVCFG_BINARY="trustzone_images\build\ms\bin\IADAANAA\devcfg.mbn"
	&EFIESP_BINARY="WP\Packages\QCOM\prebuilt\8996\firmware\EFIESP.bin"
	&ADSP_ELF="adsp_proc\build\ms\M8996AAAAAAAAQ1234.elf"
	&UEFISEC_BINARY="WP\Packages\QCOM\prebuilt\8996\firmware\tzapps.bin"
	&BOOT_BINARY="boot_images\QcomPkg\Msm8996Pkg\Bin64\xbl.elf"
)
IF ("&ARG0"=="asic_32")
(
	&PRODUCT_FLAVOR="asic_32"
	&HLOS_TYPE="WP"
	&TZ_BUILDID="IADAANAA"
	&CHIPID="msm8996"
	&MPSS_ELF="modem_proc\build\ms\M89968996.gen.prodQ00288_MCFG_HW.elf"
	&MPSS_ELF="modem_proc\build\ms\M89968996.gen.prodQ00288.elf"
	&MPSS_ELF="modem_proc\build\ms\M89968996.gen.prodQ00288_NODEVCFG.elf"
	&MPSS_ELF="modem_proc\build\ms\M89968996.gen.prodQ00288_DEVCFG.elf"
	&MPSS_ELF="modem_proc\build\ms\M89968996.gen.prodQ00288_MCFG_SW.elf"
	&MPSS_ELF="modem_proc\build\ms\M89968996.gen.prodQ00288_reloc.elf"
	&CPE_ELF="cpe_proc\build\bsp\cpe_link\build\AAAAAAAA\CPE_PROC_IMG_AAAAAAAAQ.elf"
	&BOOT_TZ_MBN="trustzone_images\build\ms\bin\IADAANAA\tz.mbn"
	&MBA_BINARY="modem_proc\build\ms\bin\8996.gen.prod\mba.mbn"
	&UEFISECAPP_BINARY="trustzone_images\build\ms\bin\IADAANAA\uefi_sec.mbn"
	&MPSS_BINARY="modem_proc\build\ms\bin\8996.gen.prod\qdsp6sw.mbn"
	&APPSCONFIG_BINARY="WP\Packages\QCOM\prebuilt\8996\firmware\8996\8996_MTP_WP\fat16.bin"
	&MBA_ELF="modem_proc\core\bsp\mba_img\build\8996.gen.prod\MBA_CORE_IMG_8996.gen.prodQ.elf"
	&ADSP_BINARY="adsp_proc\obj\qdsp6v5_ReleaseG\signed\adsp.mbn"
	&RPM_ELF="rpm_proc\core\bsp\rpm\build\RPM_AAAAANAAR.elf"
	&QSEE_ELF="trustzone_images\core\bsp\qsee\build\IADAANAA\qsee.elf"
	&SLPI_PD2_ELF="slpi_proc\build\ms\M8996AAAAAAAAQ1234_SENSOR.elf"
	&HYP_BINARY="trustzone_images\build\ms\bin\IADAANAA\hyp.mbn"
	&CPE_BINARY="cpe_proc\build\ms\bin\AAAAAAAAQ\cpe_9335.mbn"
	&VENUS_ELF="venus_proc\build\bsp\asic\build\PROD\venus.elf"
	&SLPI_ELF="slpi_proc\build\ms\M8996AAAAAAAAQ1234.elf"
	&MON_ELF="trustzone_images\core\bsp\monitor\build\IADAANAA\mon.elf"
	&SLPI_BINARY="slpi_proc\obj\qdsp6v5_ReleaseG\slpi.mbn"
	&TZ_BINARY="trustzone_images\build\ms\bin\IADAANAA\tz.mbn"
	&RPM_BINARY="rpm_proc\build\ms\bin\AAAAANAAR\rpm.mbn"
	&HYP_ELF="trustzone_images\core\bsp\hypervisor\build\IADAANAA\hyp.elf"
	&PMIC_BINARY="boot_images\QcomPkg\Msm8996Pkg\Bin64\pmic.elf"
	&ADSP_PD2_ELF="adsp_proc\build\ms\M8996AAAAAAAAQ1234_AUDIO.elf"
	&WINSECAPP_BINARY="trustzone_images\build\ms\bin\IADAANAA\winsecap.mbn"
	&VENUS_BINARY="venus_proc\build\bsp\asic\build\PROD\mbn\reloc\signed\venus.mbn"
	&TZDEVCFG_BINARY="trustzone_images\build\ms\bin\IADAANAA\devcfg.mbn"
	&EFIESP_BINARY="WP\Packages\QCOM\prebuilt\8996\firmware\EFIESP.bin"
	&ADSP_ELF="adsp_proc\build\ms\M8996AAAAAAAAQ1234.elf"
	&UEFISEC_BINARY="WP\Packages\QCOM\prebuilt\8996\firmware\tzapps.bin"
	&BOOT_BINARY="boot_images\QcomPkg\Msm8996Pkg\Bin64_Core32\xbl.elf"
)
IF ("&ARG0"=="virtio")
(
	&PRODUCT_FLAVOR="virtio"
	&HLOS_TYPE="WP"
	&TZ_BUILDID="IADAANAA"
	&CHIPID="msm8996"
	&MPSS_ELF="modem_proc\build\ms\M89968996.gen.prodQ00288_MCFG_HW.elf"
	&MPSS_ELF="modem_proc\build\ms\M89968996.gen.prodQ00288.elf"
	&MPSS_ELF="modem_proc\build\ms\M89968996.gen.prodQ00288_NODEVCFG.elf"
	&MPSS_ELF="modem_proc\build\ms\M89968996.gen.prodQ00288_DEVCFG.elf"
	&MPSS_ELF="modem_proc\build\ms\M89968996.gen.prodQ00288_MCFG_SW.elf"
	&MPSS_ELF="modem_proc\build\ms\M89968996.gen.prodQ00288_reloc.elf"
	&CPE_ELF="cpe_proc\build\bsp\cpe_link\build\AAAAAAAA\CPE_PROC_IMG_AAAAAAAAQ.elf"
	&BOOT_TZ_MBN="trustzone_images\build\ms\bin\IADAANAA\tz.mbn"
	&MBA_BINARY="modem_proc\build\ms\bin\8996.gen.prod\mba.mbn"
	&UEFISECAPP_BINARY="trustzone_images\build\ms\bin\IADAANAA\uefi_sec.mbn"
	&MPSS_BINARY="modem_proc\build\ms\bin\8996.gen.prod\qdsp6sw.mbn"
	&APPSCONFIG_BINARY="WP\Packages\QCOM\prebuilt\8996\firmware\8996\8996_MTP_WP\fat16.bin"
	&MBA_ELF="modem_proc\core\bsp\mba_img\build\8996.gen.prod\MBA_CORE_IMG_8996.gen.prodQ.elf"
	&ADSP_BINARY="adsp_proc\obj\qdsp6v5_ReleaseG\signed\adsp.mbn"
	&RPM_ELF="rpm_proc\core\bsp\rpm\build\RPM_AAAAANAAR.elf"
	&QSEE_ELF="trustzone_images\core\bsp\qsee\build\IADAANAA\qsee.elf"
	&SLPI_PD2_ELF="slpi_proc\build\ms\M8996AAAAAAAAQ1234_SENSOR.elf"
	&HYP_BINARY="trustzone_images\build\ms\bin\IADAANAA\hyp.mbn"
	&CPE_BINARY="cpe_proc\build\ms\bin\AAAAAAAAQ\cpe_9335.mbn"
	&VENUS_ELF="venus_proc\build\bsp\asic\build\PROD\venus.elf"
	&SLPI_ELF="slpi_proc\build\ms\M8996AAAAAAAAQ1234.elf"
	&MON_ELF="trustzone_images\core\bsp\monitor\build\IADAANAA\mon.elf"
	&SLPI_BINARY="slpi_proc\obj\qdsp6v5_ReleaseG\slpi.mbn"
	&TZ_BINARY="trustzone_images\build\ms\bin\IADAANAA\tz.mbn"
	&RPM_BINARY="rpm_proc\build\ms\bin\AAAAANAAR\rpm.mbn"
	&HYP_ELF="trustzone_images\core\bsp\hypervisor\build\IADAANAA\hyp.elf"
	&PMIC_BINARY="boot_images\QcomPkg\Msm8996Pkg\Bin64\pmic.elf"
	&ADSP_PD2_ELF="adsp_proc\build\ms\M8996AAAAAAAAQ1234_AUDIO.elf"
	&WINSECAPP_BINARY="trustzone_images\build\ms\bin\IADAANAA\winsecap.mbn"
	&VENUS_BINARY="venus_proc\build\bsp\asic\build\PROD\mbn\reloc\signed\venus.mbn"
	&TZDEVCFG_BINARY="trustzone_images\build\ms\bin\IADAANAA\devcfg.mbn"
	&EFIESP_BINARY="WP\Packages\QCOM\prebuilt\8996\firmware\EFIESP.bin"
	&ADSP_ELF="adsp_proc\build\ms\M8996AAAAAAAAQ1234.elf"
	&UEFISEC_BINARY="WP\Packages\QCOM\prebuilt\8996\firmware\tzapps.bin"
)
ENDDO