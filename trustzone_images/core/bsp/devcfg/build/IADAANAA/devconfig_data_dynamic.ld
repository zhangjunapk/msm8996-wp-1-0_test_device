/*===========================================================================
#
# FILE:         devconfig_data.scl
#
# DESCRIPTION:  Linker File for deviceconfig image
#
# AUTOGENERATED, DON NOT MODIFY THIS FILE
===========================================================================*/
#include "customer.h"

PHDRS {
  DEVCFG_DATA_SEG_TZ PT_LOAD;
  DEVCFG_DATA_SEG_HYP PT_LOAD;
}
SECTIONS {

   DEVCFG_DATA_TZ (DEVCFG_DATA_TZ_ADDR):
   {
      KEEP(*\DevCfgSegInfo_tz_oem.o (.rodata* .data* .sdata*)) 
      KEEP(*\8996_data_tz_oem.o (.rodata* .data* .sdata*))
      KEEP(*\DALConfig_8996_tz_oem.o (.rodata* .data* .sdata*))
      KEEP(*\8996_devcfg_BIMC_error_OEM_data.o (.rodata* .data* .sdata*))
      KEEP(*\8996_devcfg_ABT_OEM_data.o (.rodata* .data* .sdata*))
      KEEP(*\8996_devcfg_NOC_error_OEM_data.o (.rodata* .data* .sdata*))
      KEEP(*\8996_devcfg_oem_data.o (.rodata* .data* .sdata*))
      KEEP(*\8996_devcfg_pm_oem_config.o (.rodata* .data* .sdata*))
      KEEP(*\8996_devcfg_pm_spmi_config.o (.rodata* .data* .sdata*))
      KEEP(*\8996_devcfg_pm_ac_config.o (.rodata* .data* .sdata*))
      KEEP(*\8996_devcfg_pm_tz_config.o (.rodata* .data* .sdata*))
      KEEP(*\8996_devcfg_pm_config.o (.rodata* .data* .sdata*))
      KEEP(*\8996_devcfg_pm_reg_dump_config.o (.rodata* .data* .sdata*))
      ASSERT(SIZEOF(DEVCFG_DATA_TZ) <= DEVCFG_DATA_TZ_SZ, "Oversize");
   }:DEVCFG_DATA_SEG_TZ

   DEVCFG_DATA_HYP (DEVCFG_DATA_HYP_ADDR):
   {
      KEEP(*\DevCfgSegInfo_hyp_oem.o (.rodata* .data* .sdata))
      KEEP(*\8996_data_hyp_oem.o (.rodata* .data* .sdata*))
      KEEP(*\DALConfig_8996_hyp_oem.o (.rodata* .data* .sdata*))
      KEEP(*\8996_devcfg_pm_hyp_config.o (.rodata* .data* .sdata*))
      ASSERT(SIZEOF(DEVCFG_DATA_HYP) <= DEVCFG_DATA_HYP_SZ, "Oversize");
     }:DEVCFG_DATA_SEG_HYP

  .got : { * (.got) }
  .got.plt : { * (.got.plt) }
  .debug 0 : { *(.debug) }
  .line 0 : { *(.line) }

  .debug_srcinfo 0 : { *(.debug_srcinfo) }
  .debug_sfnames 0 : { *(.debug_sfnames) }

  .debug_aranges 0 : { *(.debug_aranges) }
  .debug_pubnames 0 : { *(.debug_pubnames) }

  .debug_info 0 : { *(.debug_info .gnu.linkonce.wi.*) }
  .debug_abbrev 0 : { *(.debug_abbrev) }
  .debug_line 0 : { *(.debug_line) }
  .debug_frame 0 : { *(.debug_frame) }
  .debug_str 0 : { *(.debug_str) }
  .debug_loc 0 : { *(.debug_loc) }
  .debug_macinfo 0 : { *(.debug_macinfo) }

  .debug_weaknames 0 : { *(.debug_weaknames) }
  .debug_funcnames 0 : { *(.debug_funcnames) }
  .debug_typenames 0 : { *(.debug_typenames) }
  .debug_varnames 0 : { *(.debug_varnames) }

  .debug_pubtypes 0 : { *(.debug_pubtypes) }
  .debug_ranges 0 : { *(.debug_ranges) }
  .gnu.attributes 0 : { KEEP (*(.gnu.attributes)) }
  .note.gnu.arm.ident 0 : { KEEP (*(.note.gnu.arm.ident)) }
  /DISCARD/ : { *(.ARM.exidx*) *(.note.GNU-stack) *(.gnu_debuglink) *(.gnu.lto_*) *(.init) *(.fini)}
}