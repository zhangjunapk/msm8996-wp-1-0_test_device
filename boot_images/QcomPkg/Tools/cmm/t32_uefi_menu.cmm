;============================================================================
; Name: t32_uefi_menu.cmm
;
; Description: Add UEFI specific menu item to trace 32 window
;     
; Copyright (c) 2013 Qualcomm Technologies, Inc.
; All Rights Reserved. 
; Qualcomm Technologies Proprietary and Confidential. 
;
;----------------------------------------------------------------------------

;============================================================================
;
;                        EDIT HISTORY FOR MODULE
;
;
;
;  when         who     what, where, why
;  ----------   ---     -----------------------------------------------------
;  2015-10-15   bh      Update after PATH additions
;  2013-11-22   vk      Initial version
;============================================================================;

; ---------------------------------------------------------
; Script entry point
; ---------------------------------------------------------

ENTRY

  ;Add button with L to display Serial Buffer in notepad
  ;Menu.AddTool "UART Log" "L, G" "do log_save.cmm"
  
  ;Add menu to load up symbols
  ;Menu.AddTool "Symbol Load" "S, G" "do symbol_load.cmm"
  
  ;&UefiBase is the base of FD
  &UefiBase=0x80200000

  ;Check if T32 Awareness support is available
  IF OS.FILE(~~/demo/arm/uefi/tiano/tiano.t32)==TRUE()
  (
    ;Enable the complete PA map for the awareness script
    EXT.CONFIG ~~/demo/arm/uefi/tiano/tiano.t32 0x0 0x100000000
    EXTension.Option BOOTFV &UefiBase 
  )

  MENU.ReProgram uefi.men

ENDDO
