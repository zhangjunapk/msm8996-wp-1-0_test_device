;============================================================================
;  Name:
;    sym.cmm
;
;  Description:
;     Loads UEFI symbols, after halting target
;
; Copyright (c) 2015-2016 Qualcomm Technologies Incorporated.
; All Rights Reserved.
; Qualcomm Technologies Confidential and Proprietary
;
;----------------------------------------------------------------------------
;============================================================================
;
;                        EDIT HISTORY FOR MODULE
;
;
;
; when         who     what, where, why
; ----------   ---     ----------------------------------------------------------
; 2015-10-16   bh      Fix incremental driver vs. full symbol loading
; 2015-10-15   bh      Initial revision
;============================================================================;
area.clear
area.reset
area.create UEFI_Logs 1000. 8192.
area.select UEFI_Logs

local &SecAddr
local &CwDir
local &RamCmd
local &ModName
local &ModuleBkpt
local &tfile1
local &CmdIncrOffset
global &InfoBlkAddr
global &AppObjPath
;
;  No arguments expected, just run the script from Krait 0 T32
;

ENTRY &UefiBase &LoadAllSymbols
  &CwDir=os.ppd()

  PATH + &CwDir

  do InitOffsets.cmm

  gosub VerifyInfoBlk &UefiBase
  
  &TempFile=OS.TMPFILE()
  &TempFile="&TempFile.cmm"

  &CmdSize=data.long(RD:&InfoBlkAddr+&IBlkTotalCmdSize)
  &CmdAddr=data.long(RD:&InfoBlkAddr+&IBlkSymbolCmdString)
  &CmdEnd=&CmdAddr+&CmdSize-1

  if (&LoadAllSymbols==0)
  (
    &CmdIncrOffset=data.long(RD:&InfoBlkAddr+&IBlkCmdStartOffset)
    &CmdIncrOffset=&CmdAddr+&CmdIncrOffset
    data.save.binary &TempFile &CmdIncrOffset--&CmdEnd
    data.set &InfoBlkAddr+&IBlkCmdStartOffset %LONG &CmdSize 
  )
  else
  (
    data.save.binary &TempFile &CmdAddr--&CmdEnd
  )

  cd &CwDir/../../

  do &TempFile

  if ("&AppObjPath"!="")
  (
    cd &AppObjPath
    do &TempFile
    
    cd &CwDir/../../
  )

  rm &TempFile

  if (&LoadAllSymbols==0)
  (
    &ModName=data.string(RD:&InfoBlkAddr+&IBlkModuleName)
    &ModuleBkpt="\\&ModName\AutoGen\ProcessModuleEntryPointList"
    b.s &ModuleBkpt
    go
  )

enddo


VerifyInfoBlk:
  ENTRY &ParamUefiBaseAddr
  
  local &InfFound

  &InfoBlkPtrOffset=0x00189000
  &InfoBlkAddr=&ParamUefiBaseAddr+&InfoBlkPtrOffset

  ;Read signature and verify
  &Sig=data.long(RD:&InfoBlkAddr)

  ;Check signature before dereference
  if (&Sig==0x6B6C4249)
    &InfFound=1
  else
    &InfFound=0
  
  if (&InfFound==0)
  (
    print %ERROR "UefiInfoBlk not found"
    end
  )
  else
    return
