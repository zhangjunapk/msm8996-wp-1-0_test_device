;****************************************************************************
;**         boot_debug_target_data.cmm
;**
;**         This script performs setup for debugging target on secboot 3.0 Architecture.
;**
;** Copyright  2014 - 2016 by Qualcomm Technologies, Incorporated.  All Rights Reserved.
;**
;****************************************************************************
;**
;**                        EDIT HISTORY FOR MODULE
;**
;**
;** when       who     what, where, why
;** --------   ---     ------------------------------------------------------
;** 01/06/16   kedara  Update dload cookie logic
;** 08/18/15   elt     Updated timeout and added magic num for async UART
;** 07/08/15   ck      Increased sbl1_log_timeout to 30 seconds due to DDR training
;** 06/24/15   as      Add boot timing numbers.
;** 02/20/15   kedara  Updates to change dload cookie address based on chip version.
;** 02/19/15   kedara  Updated for msm8996
;** 03/25/14   ck      Updated for Bear family
;** 08/07/12   jz      ported from target's boot_debug to make it shared

;****************************************************************************

;****************************************************************************
;  CMM script variables
;****************************************************************************
global &shared_imem_base
global &boot_dload_enable_value
global &boot_logger_loop_magic_num
global &boot_logger_async_uart_magic_num
global &shared_imem_boot_etb_addr
global &boot_dload_boot_misc_detect_addr
global &boot_debug_cookie_addr
global &boot_debug_cookie_val

;global variable for intercom name and apps core reset function
global &apcs_start_address_reg
global &rpmview_temp_apps_start_address
global &appview_temp_apps_start_address
global &pbl_bring_apps_out_of_reset_func
global &apps_reset_handler_addr
global &APPS_CORE0_T32

;global variable for boot timing
global &sbl1_log_timeout
global &sbl1_log_timeout_post_reset
global &sbl1_entry_time
global &sbl1_entry_time_post_reset
global &sbl1_dload_entry_time
global &sbl1_dload_entry_time_post_reset
global &sbl1_exit_time
global &sbl1_exit_time_post_reset

local &tcsr_soc_hw_version_reg
local &tcsr_soc_hw_version_major_version
local &tcsr_soc_hw_version_device_number

;Intercom port number for APPS core 0
&APPS_CORE0_T32="localhost:10001."

;Bear family uses ocimem as shared imem
&shared_imem_base=0x066BF000

&boot_logger_loop_magic_num=0xD1C2B3A3
&boot_logger_async_uart_magic_num=0xE1D50C10

;dload is now a bit in the BOOT_MISC_DETECT register for v3 onwards
&boot_dload_enable_value=0x10
&boot_dload_boot_misc_detect_addr=0x007B3000

; check TCSR_SOC_HW_VERSION for revision
sys.u
&tcsr_soc_hw_version_reg=DATA.LONG(EAXI:0x7a8000)
sys.d
&tcsr_soc_hw_version_major_version=((&tcsr_soc_hw_version_reg&0xFF00)>>8)
&tcsr_soc_hw_version_device_number=((&tcsr_soc_hw_version_reg&0xFFF0000)>>16)

if (&tcsr_soc_hw_version_major_version<3)
(
  if (&tcsr_soc_hw_version_device_number<4)
  (
    &boot_dload_enable_value=0x00100000
    &boot_dload_boot_misc_detect_addr=0x00361008
  )
)

;boot shared imem magic num location
&shared_imem_boot_magic_num_addr=&shared_imem_base

;boot shared imem etb pointer location
&shared_imem_boot_etb_addr=&shared_imem_base+8

;sbl1 debug cookie address and value, it's always in ocimem
&boot_debug_cookie_addr=&shared_imem_base+944
&boot_debug_cookie_val=0x53444247

;sbl1 boot times
&sbl1_log_timeout=30.s
&sbl1_log_timeout_post_reset=0.s
&sbl1_entry_time=5.s
&sbl1_entry_time_post_reset=0.s
&sbl1_dload_entry_time=5.s
&sbl1_dload_entry_time_post_reset=0.s
&sbl1_exit_time=30.s
&sbl1_exit_time_post_reset=0.s