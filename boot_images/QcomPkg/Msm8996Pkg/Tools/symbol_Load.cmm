;============================================================================
;  Name:
;    symbol_load.cmm
;
;  Description:
;     Loads UEFI symbols, after halting target
;
; Copyright (c) 2012-2015 Qualcomm Technologies Incorporated.
; All Rights Reserved.
; Qualcomm Technologies Confidential and Proprietary
;
;----------------------------------------------------------------------------
;============================================================================
;
;                        EDIT HISTORY FOR MODULE
;
;
;
; when         who     what, where, why
; ----------   ---     ----------------------------------------------------------
; 2015-10-28   bh      Clear path before executing
; 2015-10-16   bh      Get win from temp dir
; 2015-10-15   bh      Simplify debug scripts to use info block
; 2015-07-24   vk      Support Linux T32
; 2015-07-09   bh      Fix UEFI_Logs area issues
; 2015-02-11   vk      Update EntryAddress
; 2015-01-27   bh      Unifying 32/64-bit scripts
; 2014-04-10   na      Update header
; 2012-03-19   vk      Use InfoBlk for Sytem Table
; 2013-03-12   vk      Initial version
;============================================================================;
area.clear
area.reset
area.create UEFI_Logs 1000. 8192.
area.select UEFI_Logs

local &SecAddr
local &CwDir
local &LoadAllSym
;
;  No arguments expected, just run the script from APPS0 T32
;

ENTRY
  PATH 
  &CwDir=os.ppd()
  &TmpDir=os.ptd()
  PATH + &CwDir
  PATH + &CwDir/../../Tools/
  PATH + &CwDir/../../Tools/cmm

  &LoadAllSym=0x1
  
  ;Load T32 UEFI awareness
  do t32_uefi_menu.cmm

  ;Setup windows
  if (os.file("&TmpDir/win.cmm"))
  (
    do &TmpDir/win.cmm
  )
  else
  (
    do win.cmm
  )

  ;&UefiBase is the base of FD
  &UefiBase=0x80200000

  do InitOffsets.cmm
  do load_sec_sym.cmm &UefiBase &UefiBase+&SecLoadAddrOffset
  do sym.cmm &UefiBase &LoadAllSym

  cd &CwDir
enddo

