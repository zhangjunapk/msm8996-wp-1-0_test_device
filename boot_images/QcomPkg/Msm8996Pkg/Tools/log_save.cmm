;============================================================================
;  Name:
;    log_save.cmm
;
;  Description:
;     Save UEFI Debug Logs
;
; Copyright (c) 2012-2015 Qualcomm Technologies Incorporated.
; All Rights Reserved.
; Qualcomm Technologies Confidential and Proprietary
;
;----------------------------------------------------------------------------
;============================================================================
;
;                        EDIT HISTORY FOR MODULE
;
;
;
;  when         who     what, where, why
; ----------    ---     ----------------------------------------------------------
; 2015-10-28    bh      Update PATH before executing
; 2015-02-11    vk      Update EntryAddress
; 2014-04-10    na      Update header
; 2013-07-22    vk      Rename to log_save.cmm
; 2012-12-10    yg      Initial Version
;============================================================================;


local &RamEntryAddr

ENTRY &LogFileName
  PATH 
  &CwDir=os.ppd()

  PATH + &CwDir
  PATH + &CwDir/../../Tools

  &RamEntryAddr=0x80200000

  do save_dbg_log.cmm  &RamEntryAddr

enddo

